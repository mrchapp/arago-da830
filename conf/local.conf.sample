## conf/local.conf.sample
```bitbake
# WARNING: lines starting with a space (' ') will result in parse failures.
# Remove '# ' from commented lines to activate them.
#
# NOTE: Do NOT use $HOME in your paths, BitBake does NOT expand ~ for you.  If you
# must have paths relative to your homedir use ${HOME} (note the {}'s there
# you MUST have them for the variable expansion to be done by BitBake).  Your
# paths should all be absolute paths (They should all start with a / after
# expansion.  Stuff like starting with ${HOME} or ${TOPDIR} is ok).

# By default scratch area is the same as OEBASE, unless set outside by "setenv"
SCRATCH ?= "${OEBASE}"

# Use this to specify where BitBake should place the downloaded sources into
DL_DIR = "${SCRATCH}/downloads"

# Put resulting images and packages in deploy directory outside of temp
#DEPLOY_DIR = "${OEBASE}/arago-deploy"

# Default TMPDIR is safe for multi-user environment
TMPDIR = "${SCRATCH}/arago-tmp"

# Set the collections
require conf/collections.inc
COLLECTIONS = "${OEBASE}/arago/ ${OEBASE}/arago-oe-dev/"

# Optionally add BOM and Custom collections
COLLECTIONS =. "${@['', bb.data.getVar('OEBASE', d, 1)+'/arago-custom/ '][os.path.exists(bb.data.getVar('OEBASE', d, 1)+'/arago-custom/')]}"
COLLECTIONS =. "${@['', bb.data.getVar('OEBASE', d, 1)+'/arago-bom/ '][os.path.exists(bb.data.getVar('OEBASE', d, 1)+'/arago-bom/')]}"

include conf/arago-bom.conf

# Use the BBMASK below to instruct BitBake to _NOT_ consider some .bb files
# This is a regular expression, so be sure to get your parenthesis balanced.
BBMASK = "(nonworking|obsolete)"

# Enable following line to use CodeSourcery Lite, which should be in PATH
require conf/toolchain-csl.conf

# Enable following line to use MontaVista Pro 5, which should be in PATH
#require conf/toolchain-mvl5.conf

# Enable capturing license files from sources
INHERIT += "distribute_license"

# Enable generation of source packages for SDKs
require conf/arago-source-ipk.conf

# Black magic to automatically set SDK_PATH out of PATH - don't touch this!
# Works with pretty much any external toolchain, like CS Lite or MV Pro 5
# Handles cross-toolchain vs. native toolchain
# SDK_PATH can be overwritten externally by META_SDK_PATH, e.g. for SDK
TOOLCHAIN_SYSPATH = "${@bb.data.getVar('TARGET_ARCH', d, 1) != bb.data.getVar('BUILD_ARCH', d, 1) and os.path.abspath(os.path.dirname(bb.which(bb.data.getVar('PATH', d, 1), bb.data.getVar('TARGET_PREFIX', d, 1)+'cpp'))+'/../'+bb.data.getVar('TARGET_SYS', d, 1)) or ''}"
TOOLCHAIN_PATH = "${@bool(bb.data.getVar('TOOLCHAIN_SYSPATH', d, 1)) and (os.path.exists(bb.data.getVar('TOOLCHAIN_SYSPATH', d, 1)) and os.path.dirname(bb.data.getVar('TOOLCHAIN_SYSPATH', d, 1)) or bb.fatal('No valid toolchain in PATH')) or ''}"
SDK_PATH = "${@[bb.data.getVar('TOOLCHAIN_PATH', d, 1), bb.data.getVar('META_SDK_PATH', d, 1)][bool(bb.data.getVar('META_SDK_PATH', d, 1))]}"

INHERIT += "amend"
FILESPATHBASE = "${@':'.join(sorted(list(set((bb.data.getVar('FILE_DIRNAME', d, 1).replace(bb.data.getVar('OEBASE', d, 1)+'/arago-oe-dev/', bb.data.getVar('OEBASE', d, 1)+'/arago/')+':'+bb.data.getVar('FILE_DIRNAME', d, 1)).split(':'))),None,None,True))}"

# Libraries provided by the toolchain/SDK
ASSUME_SHLIBS += "libc.so.6:libc6 libm.so.6:libc6 libutil.so.1:libc6 libcrypt.so.1:libc6"
ASSUME_SHLIBS += "libdl.so.2:libc6 libpthread.so.0:libc6 librt.so.1:libc6 libgcc_s.so.1:libgcc1"
ASSUME_SHLIBS += "libstdc++.so.6:libstdc++6 libthread_db.so.1:libthread-db1"

# Set some preferences
PREFERRED_PROVIDER_initscripts = "initscripts"
PREFERRED_PROVIDER_ncurses-tools = "ncurses"
PREFERRED_PROVIDER_gdbserver = "gdbserver"
PREFERRED_VERSION_gdbserver = "6.6"
PREFERRED_VERSION_gdb = "6.6"
PREFERRED_VERSION_gdb-cross-sdk = "6.6"
PREFERRED_PROVIDER_libopkg-dev = "opkg"
PREFERRED_PROVIDER_ti-lpm-module = "ti-local-power-manager"
PREFERRED_PROVIDER_ti-dsplink-module = "ti-dsplink"
PREFERRED_PROVIDER_qt4-embedded = "qt4-embedded"
PREFERRED_VERSION_iperf = "1.7.0"

# Disable DropBear for now due to export restrictions
DISTRO_SSH_DAEMON = ""

# Disable all crypt support in curl due to export restrictions
CURL_FEATURES = "zlib,cookies,dict,file,ftp,http,telnet,tftp"

# Don't install kernel image into the filesystem
RDEPENDS_kernel-base = ""

# Specify the feed configuration
ANGSTROM_FEED_CONFIGS = "arago-feed-configs"

# Feed configuration
ARAGO_URI = "http://feeds.arago-project.org"
ARAGO_FEED_BASEPATH = "feeds/live/${ANGSTROM_PKG_FORMAT}"
DISTRO_FEED_URI = "${ARAGO_URI}/${ARAGO_FEED_BASEPATH}"

# Enabling these 2 lines will cut the initial build time by utilizing
# pre-built native staging packages. Warning: this feature is not safe
# for multi-user environment, as it sets a global temp/work directory
# TMPDIR = "/tmp/arago"
# DEPLOY_DIR_PSTAGE = "${TMPDIR}/pstage"

# Select the machine platform to build for
# The default value is "arago", which is a unified armv5te MACHINE
# to build filesystem images for OMAP3 and DaVinci
MACHINE ?= "arago"
# MACHINE = "omap3evm"
# MACHINE = "beagleboard"
# MACHINE = "davinci-dvevm"

# For now Arago is not big enough to warrant a separate distribution,
# reuse Angstrom, but set the name to Arago
DISTRO = "angstrom-2008.1"

# Set the distro name and version, since we now produce own SDK
DISTRO_NAME = "Arago"
DISTRO_VERSION = "2010.07"
BUILDNAME = "${DISTRO_NAME} ${DISTRO_VERSION}"

# Add own mirrors
INHERIT += "arago-mirrors"
#CVS_TARBALL_STASH += "http://arago-project.org/files/sources/"

# So far, angstrom.conf sets ENABLE_BINARY_LOCALE_GENERATION
# to generate binary locale packages at build time using qemu-native and
# thereby guarantee i18n support on all devices. If your build breaks on 
# qemu-native consider disabling ENABLE_BINARY_LOCALE_GENERATION (note that
# this breaks i18n on devices with less than 128MB RAM) or installing
# a working third-party qemu (e.g. provided by your distribution) and
# adding qemu-native to ASSUME_PROVIDED. Caveat emptor, since third-party
# qemus lack patches needed to work with various OE targets.
ENABLE_BINARY_LOCALE_GENERATION = "0"
# ASSUME_PROVIDED += "qemu-native"

# If ENABLE_BINARY_LOCALE_GENERATION is set to "1", you can limit locales
# generated to the list provided by GLIBC_GENERATE_LOCALES. This is huge
# time-savior for developmental builds. Format: list of locale.encoding pairs
# with spaces as separators.
# GLIBC_GENERATE_LOCALES = "en_GB.UTF-8 de_DE.UTF-8"

#INHERIT += "oestats-client"
#OESTATS_SERVER = "tinderbox.openembedded.net"
#OESTATS_BUILDER = "username"

# Add the required image file system types below. Valid are 
# jffs2, tar(.gz|bz2), cpio(.gz), cramfs, ext2(.gz), ext3(.gz)
# squashfs, squashfs-lzma
IMAGE_FSTYPES = "jffs2 tar.gz ext2.gz"

# Uncomment this if you want BitBake to emit debugging output
# BBDEBUG = "yes"

# Uncomment these two if you want BitBake to build images useful for debugging. 
# Note that INHIBIT_PACKAGE_STRIP needs a package format to be defined.
# Also note that OE now produces -dbg packages which contain debugging symbols.
# DEBUG_BUILD = "1"
# INHIBIT_PACKAGE_STRIP = "1"

# Uncomment these to build a package such that you can use gprof to profile it.
# NOTE: This will only work with 'linux' targets, not
# 'linux-uclibc', as uClibc doesn't provide the necessary
# object files.  Also, don't build glibc itself with these
# flags, or it'll fail to build.
#
# PROFILE_OPTIMIZATION = "-pg"
# SELECTED_OPTIMIZATION = "${PROFILE_OPTIMIZATION}"
# LDFLAGS =+ "-pg"

# Uncomment this to enable parallel make.
# This allows make to spawn mutliple processes to take advantage of multiple 
# processors. Useful on SMP machines. This may break some packages - we're
# in the process of marking these so let us know if you find any.
#PARALLEL_MAKE = "-j 4"
#BB_NUMBER_THREADS = "4"

# Uncomment this if you want BitBake to emit the log if a build fails.
BBINCLUDELOGS = "yes"

# Uncomment this to remove work directory after packaging to save disk space
# INHERIT += "rm_work"
```

## conf/machine/arago.conf
```bitbake
#@TYPE: Machine
#@NAME: Arago unified machine
#@DESCRIPTION: Unified Arago machine configuration for the TI OMAP3 and DaVinci platforms
TARGET_ARCH = "arm"

PREFERRED_PROVIDER_virtual/xserver = "xserver-kdrive"
XSERVER = "xserver-kdrive-fbdev"
GUI_MACHINE_CLASS = "smallscreen"

#include conf/machine/include/tune-cortexa8.inc
include conf/machine/include/tune-arm926ejs.inc

IMAGE_FSTYPES ?= "jffs2 tar.bz2"
EXTRA_IMAGECMD_jffs2 = "-lnp "

SERIAL_CONSOLE = ""

PREFERRED_PROVIDER_virtual/kernel ?= "linux-arago"

KERNEL_IMAGETYPE = "uImage"

UBOOT_ENTRYPOINT = "0x80008000"
UBOOT_LOADADDRESS = "0x80008000"
UBOOT_ARCH = "arm"

MACHINE_FEATURES = "kernel26 apm usbgadget usbhost vfat ext2 screen touchscreen"
```

## conf/machine/da830_omapl137-evm.conf
```bitbake
#@TYPE: Machine
#@NAME: DA830 CPUs on a DA830/OMAPL137 EVM board
#@DESCRIPTION: Machine configuration for the TI DA830/OMAPL137 EVM board

require conf/machine/include/davinci.inc

PREFERRED_VERSION_virtual/kernel = "da830_omapl137"

UBOOT_MACHINE = "da830_omapl137_config"
UBOOT_ENTRYPOINT = "0xc0008000"
UBOOT_LOADADDRESS = "0xc0008000"

MACHINE_FEATURES = "kernel26 serial ethernet"
```

## conf/machine/da850-sdi.conf
```bitbake
#@TYPE: Machine
#@NAME: DA850 CPUs on a DA850 SDI board
#@DESCRIPTION: Machine configuration for the SDI DA850 EVM board

require conf/machine/include/davinci.inc
require conf/machine/include/omapl138.inc

UBOOT_MACHINE = "da850_sdi_config"
UBOOT_ENTRYPOINT = "0xc0008000"
UBOOT_LOADADDRESS = "0xc0008000"

MACHINE_FEATURES = "kernel26 serial ethernet"

SERIAL_CONSOLE = "115200 ttyS2"

PREFERRED_PROVIDER_virtual/kernel = "linux-omapl1"
```

## conf/machine/dm355-evm.conf
```bitbake
#@TYPE: Machine
#@NAME: DM355 CPUs on a Davinci DM355 EVM board
#@DESCRIPTION: Machine configuration for the TI Davinci DM355 EVM board

require conf/machine/include/davinci.inc

PREFERRED_VERSION_u-boot = "2009.05+2009.06-rc0"
UBOOT_MACHINE = "davinci_dm355_evm_config"
```

## conf/machine/dm357-evm.conf
```bitbake
#@TYPE: Machine
#@NAME: DM357 CPUs on a Davinci DM357 EVM board
#@DESCRIPTION: Machine configuration for the TI Davinci DM357 EVM board

require conf/machine/include/davinci.inc

PREFERRED_PROVIDER_xserver = "xserver-kdrive"
PREFERRED_PROVIDERS += "virtual/${TARGET_PREFIX}depmod:module-init-tools-cross"

PREFERRED_VERSION_u-boot = "git"
UBOOT_MACHINE = "davinci_dvevm_config"

#MACHINE_EXTRA_RRECOMMENDS = ""
```

## conf/machine/dm365-evm.conf
```bitbake
#@TYPE: Machine
#@NAME: DM365 CPUs on a Davinci DM365 EVM board
#@DESCRIPTION: Machine configuration for the TI Davinci DM365 EVM board

require conf/machine/include/davinci.inc

PREFERRED_VERSION_u-boot = "2009.05+2009.06-rc0"
UBOOT_MACHINE = "davinci_dm365_evm_config"
```

## conf/machine/dm6446-evm.conf
```bitbake
#@TYPE: Machine
#@NAME: DM644x CPUs on a Davinci DM6446 EVM board
#@DESCRIPTION: Machine configuration for the TI Davinci DM6446 EVM board

require conf/machine/include/davinci.inc

PREFERRED_VERSION_u-boot = "2009.05+2009.06-rc0"
UBOOT_MACHINE = "davinci_dvevm_config"
```

## conf/machine/dm6467-evm.conf
```bitbake
#@TYPE: Machine
#@NAME: DM646x CPUs on a Davinci HD DM6467 EVM board
#@DESCRIPTION: Machine configuration for the TI Davinci HD DM6467 EVM board

require conf/machine/include/davinci.inc

PREFERRED_VERSION_u-boot = "2009.05+2009.06-rc0"
UBOOT_MACHINE = "davinci_dm6467_evm_config"
```

## conf/machine/include/davinci.inc
```bitbake
require conf/machine/include/tune-arm926ejs.inc

# Increase this everytime you change something in the kernel
MACHINE_KERNEL_PR = "r0"

TARGET_ARCH = "arm"

HOTPLUG = "udev"

PREFERRED_PROVIDER_virtual/kernel = "linux-davinci"

KERNEL_IMAGETYPE = "uImage"

UBOOT_ENTRYPOINT = "0x80008000"
UBOOT_LOADADDRESS = "0x80008000"

#EXTRA_IMAGEDEPENDS += "u-boot ubl"

SERIAL_CONSOLE ?= "115200 ttyS0"
EXTRA_IMAGECMD_jffs2 = "--pad --little-endian --eraseblock=0x20000 -n"

#ROOT_FLASH_SIZE = "29"

MACHINE_FEATURES += " kernel26 serial usbhost alsa "
```

## conf/machine/include/dm355.inc
```bitbake
# DMAI
PLATFORM      = "dm355"
XDC_PLATFORM  = ti.platforms.evmDM355

# Obsoleted (CE examples rebuild)
#DEVICES       = "DM355"
#GPPOS         = "LINUX_GCC"
#PROGRAMS      = "APP_LOCAL"

# DMAI recipe
#TARGET        = "dm355_al"
```

## conf/machine/include/omap3.inc
```bitbake
require conf/machine/include/tune-cortexa8.inc
PREFERRED_PROVIDER_virtual/kernel = "linux-omap"
# Increase this everytime you change something in the kernel
MACHINE_KERNEL_PR = "r50"

KERNEL_IMAGETYPE = "uImage"

UBOOT_ENTRYPOINT = "0x80008000"
UBOOT_LOADADDRESS = "0x80008000"

# Only build u-boot, xload is optional
#EXTRA_IMAGEDEPENDS += "u-boot"

# TI DVSDK stuff:
# DSPLink rebuild
DSPLINKDSPCFG     ?= "OMAP3530SHMEM"
DSPLINKGPPOS      ?= "OMAPLSP"
DSPLINKPLATFORM   ?= "OMAP3530"
DSPLINKSOC        ?= "3530"

# LPM
LPMDSPPOWERSOC    ?= "omap3530"

# DMAI
PLATFORM          ?= "omap3530"
XDC_PLATFORM      ?= "ti.platforms.evm3530"

# Obsoleted (CE examples rebuild)
#DSPCFG            ?= "OMAP3530SHMEM"
#DSPPOWERSOC       ?= "omap3530"
#GPPOS             ?= "LINUX_GCC"
#DEVICES           ?= "OMAP3530"
```
